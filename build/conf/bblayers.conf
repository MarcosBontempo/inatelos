## build/conf/bblayers.conf
```bitbake
# LAYER_CONF_VERSION is increased each time build/conf/bblayers.conf
# changes incompatibly
LCONF_VERSION = "6"

BBPATH = "${TOPDIR}"
BBFILES ?= ""

BBLAYERS ?= " \
  ${TOPDIR}/../poky-daisy/meta \
  ${TOPDIR}/../poky-daisy/meta-yocto \
  ${TOPDIR}/../poky-daisy/meta-yocto-bsp \
  ${TOPDIR}/../inatelos/meta-embarcados \
  ${TOPDIR}/../inatelos/meta-embarcados/meta-rpi \
  ${TOPDIR}/../inatelos/meta-raspberrypi \
  ${TOPDIR}/../inatelos/meta-qt5 \
  ${TOPDIR}/../inatelos/meta-openembedded/meta-oe \
  ${TOPDIR}/../poky-daisy/meta \
  ${TOPDIR}/../poky-daisy/meta-yocto \
  "
BBLAYERS_NON_REMOVABLE ?= " \
  ${TOPDIR}/../poky-daisy/meta \
  ${TOPDIR}/../poky-daisy/meta-yocto \
  "
```
